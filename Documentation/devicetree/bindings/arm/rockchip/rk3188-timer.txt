## Documentation/devicetree/bindings/arm/rockchip/rk3188-timer.txt
```
Rockchip rk3188 timer:
----------------------

The rk3188 SoCs contain a slightly modified dw-apb-timer.

Required node properties:
- compatible value : = "rockchip,rk3188-dw-apb-timer-osc";

For the other properties see the generic documentation in
../../rtc/dw-apb.txt

Example:

	timer3: timer@ffe00000 {
			compatible = "rockchip,rk3188-dw-apb-timer-osc";
			interrupts = <0 170 4>;
			reg = <0xffe00000 0x1000>;
			clocks = <&timer_clk>, <&timer_pclk>;
			clock-names = "timer", "pclk";
		};
```

## Documentation/devicetree/bindings/arm/rockchip/smp-sram.txt
```
Rockchip SRAM for smp bringup:
------------------------------

Rockchip's smp-capable SoCs use the first part of the sram for the bringup
of the cores. Once the core gets powered up it executes the code that is
residing at the very beginning of the sram.

Therefore a reserved section has to be added to the mmio-sram declaration.

Required node properties:
- compatible : should contain both "rockchip,rk3066-sram", "mmio-sram"
  so that the smp code can select the correct sram node.

The rest of the properties should follow the generic mmio-sram discription
found in ../../misc/sram.txt

Example:

	sram: sram@10080000 {
		compatible = "rockchip,rk3066-sram", "mmio-sram";
		reg = <0x10080000 0x10000>;
		mmio-sram-reserved = <0x0 0x50>;
	};
```

## Documentation/devicetree/bindings/i2c/i2c-rk3x.txt
```
* Rockchip RK3xxx I2C controller

This driver interfaces with the native I2C controller present in Rockchip
RK3xxx SoCs.

Required properties :

 - reg : Offset and length of the register set for the device
 - compatible : should be "rockchip,rk3066-i2c", "rockchip,rk3188-i2c" or
		"rockchip,rk3288-i2c".
 - interrupts : interrupt number
 - clocks : parent clock

Required on RK3066, RK3188 :

 - rockchip,grf : the phandle of the syscon node for the general register
		  file (GRF)
 - rockchip,bus-index : index of the bus in the GRF

Optional properties :

 - clock-frequency : SCL frequency to use (in Hz). If omitted, 100kHz is used.

Example:

i2c0: i2c@2002d000 {
	compatible = "rockchip,rk3188-i2c";
	reg = <0x2002d000 0x1000>;
	interrupts = <GIC_SPI 40 IRQ_TYPE_LEVEL_HIGH>;
	#address-cells = <1>;
	#size-cells = <0>;

	rockchip,grf = <&grf>;
	rockchip,bus-index = <0>;

	clock-names = "i2c";
	clocks = <&cru PCLK_I2C0>;
};
```

## Documentation/devicetree/bindings/misc/sram.txt
```
Generic on-chip SRAM

Simple IO memory regions to be managed by the genalloc API.

Required properties:

- compatible : mmio-sram

- reg : SRAM iomem address range

Optional properties:

- available: optional list of available chunks inside the sram that the
  OS can use. Without the available property the whole range is usable.
  Format is <base size>, <base size>, ...; with base being relative to the
  reg property base.

Example:

sram: sram@5c000000 {
	compatible = "mmio-sram";
	reg = <0x5c000000 0x40000>; /* 256 KiB SRAM at address 0x5c000000 */
	available = <0x100 0x39900>;
};
```

## Documentation/devicetree/bindings/watchdog/snps-dw-apb-wdt.txt
```
* Synosis DesignWare APB Watchdog

The Watchdog controller is used for resuming system operation
after a preset amount of time during which the WDT reset event has not
occurred.

Required properties:
- compatible : "snps,dw-apb-wdt"
- reg : offset and length of the register set for the device.
- clocks : the periphal clock of the controller.

Example:

	watchdog@2004c000 {
		compatible = "snps,dw-apb-wdt";
		reg = <0x2004c000 0x100>;
		clocks = <&wdt_clock>;
	};
```
